&contexthub_0 {
	multi-os = "disabled";
};

/ {
	fragment@model {
		target-path = "/";
		__overlay__ {
			shub {
				compatible = "shub";
			};
		};
	};
};

/* /home/dpi/qb5_8814/workspace/P4_1716/android/kernel/kmodule/sensorhub/lsi/s5e8845/dts/sensorhub_s5e8845.m56x.dtsi */
/ {
	fragment@model {
		target-path = "/";
		__overlay__ {
			shub {
				acc-lsm6dsvtr-position = <3>;
				mag-mxg4300s-position = <0>;
				mag-mxg4300s-array = /bits/ 8 <39 39 3 34 1 182 1 45 36 175 254 81 0 120 255 253 40 47 0 0 0 0 0 0 0 0 0>;
				light-position = /bits/ 32 <38 54 11 78 3 0>;
			};
		};
	};
};
/* /home/dpi/qb5_8814/workspace/P4_1716/android/kernel/kmodule/sensorhub/lsi/s5e8845/dts/sensorhub_s5e8845.m56x.04.dtsi */
/ {
	fragment@model {
		target-path = "/";
		__overlay__ {
			shub {
				acc-lsm6dsvtr-position = <2>;
				mag-mxg4300s-position = <3>;
			};
		};
	};
};