&smd{
	sec_lp_thermistor: sec_thermistor@3 {
		compatible = "samsung,sec-thermistor";
		status = "okay";
		thermistor_name = "sec-lp-thermistor";
		id = <3>;

		io-channels = SEC_ADC(s2mpu15_gpadc,4);
		io-channel-names = "adc-lp-temp";
		io-channel-ranges;
	};
};
